## Documentation/devicetree/bindings/scsi/hisilicon-sas.txt
```
* HiSilicon SAS controller

The HiSilicon SAS controller supports SAS/SATA.

Main node required properties:
  - compatible : value should be as follows:
	(a) "hisilicon,hip05-sas-v1" for v1 hw in hip05 chipset
	(b) "hisilicon,hip06-sas-v2" for v2 hw in hip06 chipset
  - sas-addr : array of 8 bytes for host SAS address
  - reg : Address and length of the SAS register
  - hisilicon,sas-syscon: phandle of syscon used for sas control
  - ctrl-reset-reg : offset to controller reset register in ctrl reg
  - ctrl-reset-sts-reg : offset to controller reset status register in ctrl reg
  - ctrl-clock-ena-reg : offset to controller clock enable register in ctrl reg
  - queue-count : number of delivery and completion queues in the controller
  - phy-count : number of phys accessible by the controller
  - interrupts : For v1 hw: Interrupts for phys, completion queues, and fatal
		sources; the interrupts are ordered in 3 groups, as follows:
		  - Phy interrupts
		  - Completion queue interrupts
		  - Fatal interrupts
		Phy interrupts : Each phy has 3 interrupt sources:
			- broadcast
			- phyup
			- abnormal
		The phy interrupts are ordered into groups of 3 per phy
		(broadcast, phyup, and abnormal) in increasing order.
		Completion queue interrupts : each completion queue has 1
			interrupt source. The interrupts are ordered in
			increasing order.
		Fatal interrupts : the fatal interrupts are ordered as follows:
			- ECC
			- AXI bus
		For v2 hw: Interrupts for phys, Sata, and completion queues;
		the interrupts are ordered in 3 groups, as follows:
		  - Phy interrupts
		  - Sata interrupts
		  - Completion queue interrupts
		Phy interrupts : Each controller has 2 phy interrupts:
			- phy up/down
			- channel interrupt
		Sata interrupts : Each phy on the controller has 1 Sata
			interrupt. The interrupts are ordered in increasing
			order.
		Completion queue interrupts : each completion queue has 1
			interrupt source. The interrupts are ordered in
			increasing order.

Optional main node properties:
 - am-max-trans : limit controller for am max transmissions

* HiSilicon SAS syscon

Required properties:
- compatible: should be "hisilicon,sas-ctrl", "syscon"
- reg: offset and length of the syscon sas-ctrl registers


Example:
	sas_ctrl0: sas_ctrl@c0000000 {
		compatible = "hisilicon,sas-ctrl", "syscon";
		reg = <0x0 0xc0000000 0x0 0x10000>;
	};

	sas0: sas@c1000000 {
		compatible = "hisilicon,hip05-sas-v1";
		sas-addr = [50 01 88 20 16 00 00 0a];
		reg = <0x0 0xc1000000 0x0 0x10000>;
		hisilicon,sas-syscon = <&sas_ctrl0>;
		ctrl-reset-reg = <0xa60>;
		ctrl-reset-sts-reg = <0x5a30>;
		ctrl-clock-ena-reg = <0x338>;
		queue-count = <32>;
		phy-count = <8>;
		dma-coherent;
		interrupt-parent = <&mbigen_dsa>;
		interrupts = <259 4>, <263 4>,<264 4>,/* phy irq(0~79) */
				<269 4>,<273 4>,<274 4>,/* phy irq(0~79) */
				<279 4>,<283 4>,<284 4>,/* phy irq(0~79) */
				<289 4>,<293 4>,<294 4>,/* phy irq(0~79) */
				<299 4>,<303 4>,<304 4>,/* phy irq(0~79) */
				<309 4>,<313 4>,<314 4>,/* phy irq(0~79) */
				<319 4>,<323 4>,<324 4>,/* phy irq(0~79) */
				<329 4>,<333 4>,<334 4>,/* phy irq(0~79) */
				<336 1>,<337 1>,<338 1>,<339 1>,<340 1>,
				<341 1>,<342 1>,<343 1>,/* cq irq (80~111) */
				<344 1>,<345 1>,<346 1>,<347 1>,<348 1>,
				<349 1>,<350 1>,<351 1>,/* cq irq (80~111) */
				<352 1>,<353 1>,<354 1>,<355 1>,<356 1>,
				<357 1>,<358 1>,<359 1>,/* cq irq (80~111) */
				<360 1>,<361 1>,<362 1>,<363 1>,<364 1>,
				<365 1>,<366 1>,<367 1>,/* cq irq (80~111) */
				<376 4>,/* chip fatal error irq(120) */
				<381 4>;/* chip fatal error irq(125) */
		status = "disabled";
	};
```

## drivers/of/Kconfig.numa
```kconfig
config NUMA
	bool "Numa Memory Allocation and Scheduler Support"
	depends on SMP
	select HAVE_MEMBLOCK_NODE_MAP
	help
	  Say Y to compile the kernel to support NUMA (Non-Uniform Memory
	  Access).

	  The kernel will try to allocate memory used by a CPU on the
	  local memory controller of the CPU and add some more
	  NUMA awareness to the kernel.

	  If in doubt, say N.

config NODES_SHIFT
	int "Max num nodes shift(1-10)"
	range 1 10
	default "1"
	depends on NEED_MULTIPLE_NODES
	help
	  This option specifies the maximum number of nodes on the target
	  system. MAX_NUMNODES will be 2^(This value).
	  If in doubt, use the default.

config OF_NUMA
	def_bool y
	depends on NUMA

config USE_PERCPU_NUMA_NODE_ID
	def_bool y
	depends on NUMA

config HAVE_SETUP_PER_CPU_AREA
	def_bool y
	depends on NUMA

config NEED_PER_CPU_EMBED_FIRST_CHUNK
	def_bool y
	depends on NUMA

config HAVE_MEMORYLESS_NODES
	def_bool y
	depends on NUMA
```
